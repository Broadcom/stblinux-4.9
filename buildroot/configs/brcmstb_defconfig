## buildroot/configs/brcmstb_defconfig
```kconfig
BR2_FORCE_HOST_BUILD=y
BR2_TOOLCHAIN_EXTERNAL=y
BR2_TOOLCHAIN_EXTERNAL_CUSTOM=y
BR2_TOOLCHAIN_EXTERNAL_GCC_6=y
BR2_TOOLCHAIN_EXTERNAL_CUSTOM_GLIBC=y
BR2_TOOLCHAIN_EXTERNAL_CXX=y
BR2_TOOLCHAIN_EXTERNAL_LIBASAN=y
BR2_TOOLCHAIN_EXTERNAL_LIBLSAN=y
BR2_TOOLCHAIN_EXTERNAL_LIBTSAN=y
BR2_TOOLCHAIN_EXTERNAL_LIBUBSAN=y
BR2_TARGET_GENERIC_HOSTNAME="brcmstb"
BR2_ROOTFS_DEVICE_TABLE="board/brcmstb/device_table.txt"
BR2_ROOTFS_POST_BUILD_SCRIPT="board/brcmstb/post-build.sh"
BR2_ROOTFS_POST_IMAGE_SCRIPT="board/brcmstb/post-image.sh"
BR2_ROOTFS_POST_SCRIPT_ARGS="$(BR2_LINUX_KERNEL_VERSION)"
BR2_LINUX_KERNEL=y
BR2_LINUX_KERNEL_CUSTOM_GIT=y
BR2_LINUX_KERNEL_XZ=y
BR2_PACKAGE_LINUX_TOOLS_CPUPOWER=y
BR2_PACKAGE_LINUX_TOOLS_PERF=y
BR2_PACKAGE_LINUX_TOOLS_PERF_TUI=y
BR2_PACKAGE_LINUX_TOOLS_TMON=y
BR2_PACKAGE_BUSYBOX_CONFIG_FRAGMENT_FILES="board/brcmstb/busybox.fragment"
BR2_PACKAGE_BUSYBOX_SHOW_OTHERS=y
BR2_PACKAGE_BRCM_PM=y
BR2_PACKAGE_BRCM_SCRIPTS=y
BR2_PACKAGE_CMATOOL=y
BR2_PACKAGE_MOCA2=y
BR2_PACKAGE_BZIP2=y
BR2_PACKAGE_XZ=y
BR2_PACKAGE_ZIP=y
BR2_PACKAGE_BONNIE=y
BR2_PACKAGE_DHRYSTONE=y
BR2_PACKAGE_EBTABLES=y
BR2_PACKAGE_GDB=y
BR2_PACKAGE_STRACE=y
BR2_PACKAGE_DOSFSTOOLS=y
BR2_PACKAGE_DOSFSTOOLS_FSCK_FAT=y
BR2_PACKAGE_E2FSPROGS=y
BR2_PACKAGE_E2FSPROGS_E2IMAGE=y
BR2_PACKAGE_E2FSPROGS_E4DEFRAG=y
BR2_PACKAGE_E2FSPROGS_RESIZE2FS=y
BR2_PACKAGE_ELFUTILS=y
BR2_PACKAGE_ZLIB=y
BR2_PACKAGE_LIBUNWIND=y
BR2_PACKAGE_LM_SENSORS=y
BR2_PACKAGE_LM_SENSORS_SENSORS=y
BR2_PACKAGE_LM_SENSORS_FANCONTROL=y
BR2_PACKAGE_LM_SENSORS_PWMCONFIG=y
BR2_PACKAGE_MMC_UTILS=y
BR2_PACKAGE_MTD=y
BR2_PACKAGE_XFSPROGS=y
BR2_PACKAGE_CPUFREQUTILS=y
BR2_PACKAGE_GPTFDISK=y
BR2_PACKAGE_GPTFDISK_GDISK=y
BR2_PACKAGE_GPTFDISK_SGDISK=y
BR2_PACKAGE_HDPARM=y
BR2_PACKAGE_I2C_TOOLS=y
BR2_PACKAGE_IOSTAT=y
BR2_PACKAGE_RNG_TOOLS=y
BR2_PACKAGE_SETSERIAL=y
BR2_PACKAGE_DROPBEAR=y
BR2_PACKAGE_ETHTOOL=y
# BR2_PACKAGE_ETHTOOL_PRETTY_PRINT is not set
BR2_PACKAGE_IPTABLES=y
BR2_PACKAGE_IPTRAF_NG=y
BR2_PACKAGE_PORTMAP_STB=y
BR2_PACKAGE_BASH=y
BR2_PACKAGE_SCREEN=y
BR2_PACKAGE_KMOD=y
BR2_PACKAGE_KMOD_TOOLS=y
BR2_PACKAGE_LXC=y
BR2_PACKAGE_PROCPS_NG=y
BR2_PACKAGE_TRACE_CMD=y
BR2_PACKAGE_UTIL_LINUX_BINARIES=y
BR2_PACKAGE_UTIL_LINUX_AGETTY=y
BR2_PACKAGE_UTIL_LINUX_CAL=y
BR2_PACKAGE_UTIL_LINUX_CRAMFS=y
BR2_PACKAGE_UTIL_LINUX_HWCLOCK=y
BR2_PACKAGE_UTIL_LINUX_SCHEDUTILS=y
BR2_TARGET_ROOTFS_INITRAMFS=y
BR2_TARGET_ROOTFS_TAR_GZIP=y
BR2_PACKAGE_HOST_MTD=y
BR2_PACKAGE_HOST_SQUASHFS=y
```

## buildroot/package/brcm-pm/Config.in
```kconfig
config BR2_BRCM_STB_TOOLS_VERSION
	string "Broadcom STB tools version"
	default d9e91daae00b
	help
	  Specify the git hash of the stbtools version you want to use. The
	  hash can be abbreviated if it is unique.

config BR2_PACKAGE_BRCM_PM
	bool "Broadcom Power Management Tools"
	help
	  Broadcom power management tools allow easy access to power management
	  features.

	  Say Y, if you are using Broadcom hardware.
```

## buildroot/package/brcm-scripts/Config.in
```kconfig
config BR2_PACKAGE_BRCM_SCRIPTS
	bool "Broadcom Scripts"
	help

	  Broadcom scripts for power management and other tasks.

	  Say Y, if you are using Broadcom STB.
```

## buildroot/package/brcm-skel/Config.in
```kconfig
config BR2_PACKAGE_BRCM_SKEL
	bool "Broadcom Skeleton"
	help

	  Broadcom skeleton scripts (/etc, power management scripts, etc.)

	  Say Y, if you are using Broadcom STB.
```

## buildroot/package/brcm-test-modules/Config.in
```kconfig
menu "Broadcom STB test modules"

config BR2_PACKAGE_BRCM_TEST_MODULES_DVFS_API
	bool "DVFS API test module"

config BR2_PACKAGE_BRCM_TEST_MODULES_GPIO_API
	bool "GPIO API test module"

config BR2_PACKAGE_BRCM_TEST_MODULES_IRQ_API
	bool "IRQ API test module"

config BR2_PACKAGE_BRCM_TEST_MODULES_MEMORY_API
	bool "Memory API test module"

config BR2_PACKAGE_BRCM_TEST_MODULES_REG_API
	bool "Register API test module"

endmenu
```

## buildroot/package/cmatool/Config.in
```kconfig
config BR2_PACKAGE_CMATOOL
	bool "cmatool"
	help

	  Broadcom CMA tools allow userspace access to Broadcom CMA, which is
	  a contiguous memory area reserved for use by Broadcom middleware.

	  Say Y, if you are using Broadcom middleware.
```

## buildroot/package/cpufrequtils/Config.in
```kconfig
config BR2_PACKAGE_CPUFREQUTILS
	bool "cpufrequtils"
	help
		cpufrequtils is a package of user space commands that
		allow easy interaction with the CPUfreq sub-system,
		such as setting or checking the current governor.

		https://packages.debian.org/wheezy/cpufrequtils
```

## buildroot/package/glibc/Config.in.host
```kconfig
config BR2_PACKAGE_HOST_GLIBC
	bool "host glibc"
	help
	  Host package of GLIBC for the purpose of building ldconfig.
	  https://www.gnu.org/software/libc/

	  Don't say 'y' unless you know what you are doing.
```

## buildroot/package/moca2/Config.in
```kconfig
config BR2_PACKAGE_MOCA2
	bool "MOCA2"
	help

	  Broadcom STB MOCA2 tools.

	  Say Y, if you are using Broadcom set-top box hardware.
```

## buildroot/package/portmap_stb/Config.in
```kconfig
config BR2_PACKAGE_PORTMAP_STB
	bool "portmap"
	help
	  Portmap is a server that converts RPC program numbers into DARPA
	  protocol port numbers. It must be running in order to make RPC calls.

	  https://fossies.org/linux/misc/old/portmap-6.0.tgz/
```

## linux/Documentation/devicetree/bindings/mailbox/brcmstb-mailbox.txt
```
Brcmstb mailbox

The Brcmstb mailbox is used as the companion mailbox driver for SCMI
communications.

Refer to ./mailbox.txt for generic information about mailbox device-tree
bindings.

Required properties:

 - compatible: should be one of the following.
   - "brcm,brcmstb-mbox"
 - interrupts: The interrupt number to the for the SCMI A2P channel
	and optionally the interrupt number for the P2A channel.
 - #mbox-cells: Common mailbox binding property to identify the number
	of cells required for the mailbox specifier. Should be 1.

Example:
--------

mbox: mbox@ff6b0000 {
	compatible = "brcm,brcmstb-mbox";
	interrupts = <GIC_SGI 13 IRQ_TYPE_LEVEL_HIGH>,
		     <GIC_SGI 11 IRQ_TYPE_LEVEL_HIGH>;
	#mbox-cells = <1>;
};
```

## linux/Documentation/devicetree/bindings/pci/brcmstb-pci.txt
```
Brcmstb PCIe Host Controller Device Tree Bindings

Introduction:
  The brcmstb host controller closely follows the example set in

	[1] http://devicetree.org/Device_Tree_Usage#PCI_Host_Bridge

  The rest of this document explains some added customizations and
  offers an example Brcmstb PCIe host controller DT node.

Required Properties:
  reg -- the register start address and length for the PCIe block.
      Additional start,length pairs may be specified for clock addresses.
  interrupts -- two interrupts are specified; the first interrupt is for
      the PCI host controller and the second is for MSI if the built-in
      MSI controller is to be used.
  interrupt-names -- names of the interrupts (above): "pcie" and "msi".
  compatible -- must be one of: "brcm,bcm7425-pcie", "brcm,bcm7435-pcie",
      "brcm,bcm7278-pcie" or "brcm,pci-plat-dev".
  #address-cells -- the number of address cells for PCI-space.
  #size-cells -- the number of size cells for PCI-space.
  ranges -- See [1]; a specification of the outbound windows for the host
      controller.  Each outbound window is described by a n-tuple:
          (3 cells) -- PCIe space start address; one cell for attributes
                       and two cells for the 64-bit PCIe address.
          (x cells) -- CPU/System start address, number of cells is determined
                       by the parent node's #address-cells.
          (y cells) -- Size of region, number of cells determined by the
                       parent node's #size-cells.
      Due to hardware limitations, there may be a maximum of four
      non-contiguous ranges specified.
  #interrupt-cells -- number of cells used to describe the interrupt.
  interrupt-map-mask -- see [1]; four cells, the first three are zero
      for our uses and the fourth cell is the mask (val = 0x7) for
      the legacy interrupt number [1..4].
  interrupt-map -- See [1]; there are four interrupts (INTA, INTB,
      INTC, and INTD) to be mapped; each interrupt requires 5 cells
      plus the size of the interrupt specifier.

Optional Properties:
  clocks -- list of clock phandles.  If specified, this should list one
      clock.
  clock-names -- the "local" names of the clocks specified in 'clocks'.  Note
      that if the 'clocks' property is given, 'clock-names' is mandatory,
      and the name of the clock is expected to be "sw_pcie".
  dma-ranges -- Similar in structure to ranges, each dma region is
      specified with a n-tuple.  Dma-regions describe the inbound
      accesses from EP to RC; it translates the pci address that the
      EP "sees" to the CPU address in memory.  This property is needed
      because the design of the Brcmstb memory subsystem often precludes
      idenity-mapping between CPU address space and PCIe address space.
      Each range is described by a n-tuple:
          (3 cells) -- PCIe space start address; one cell for attributes
                       and two cells for the 64-bit PCIe address.
          (x cells) -- CPU/System start address, number of cells is determined
                       by the parent node's #address-cells.
          (y cells) -- Size of region, number of cells determined by the
                       parent node's #size-cells.
  msi-parent -- if MSI is to be used, this must be a phandle to the
      msi-parent.  If this prop is set to the phandle of the PCIe
      node, or if the msi-parent prop is missing, the PCIE controller
      will attempt to use its built in MSI controller.
  msi-controller -- this property should only be specified if the
      PCIe controller is using its internal MSI controller.
  brcm,ssc -- (boolean) indicates usage of spread-spectrum clocking.
  brcm,gen --  (integer) indicates desired generation of link:
      1 => 2.5 Gbps, 2 => 5.0 Gbps, 3 => 8.0 Gbps.
  supply-names -- the names of voltage regulators that the root
      complex should turn off/on/on on suspend/resume/boot.  This
      is a string list.
  supplies -- A collection of phandles to a regulator nodes, see
      Documentation/devicetree/bindings/regulator/ for specific
      bindings. The number and order of phandles must match
      exactly the number of strings in the "supply-names" property.
  brcm,aspm-en-l0s -- (boolean) Enable ASPM L0s as well as L1. By
      default, only ASPM L1 is enabled as our measurements indicate
      (a) l0s doesn't save that much power and (b) l0s may introduce
      a formidable noise signal.

Example Node:

pcie0:	pcie@f0460000 {
		reg = <0x0 0xf0460000 0x0 0x9310>;
		interrupts = <0x0 0x0 0x4>;
		compatible = "brcm,pci-plat-dev";
		#address-cells = <3>;
		#size-cells = <2>;
		ranges = <0x02000000 0x00000000 0x00000000 0x00000000 0xc0000000 0x00000000 0x08000000
			  0x02000000 0x00000000 0x08000000 0x00000000 0xc8000000 0x00000000 0x08000000>;
		#interrupt-cells = <1>;
		interrupt-map-mask = <0 0 0 7>;
		interrupt-map = <0 0 0 1 &intc 0 47 3
				 0 0 0 2 &intc 0 48 3
				 0 0 0 3 &intc 0 49 3
				 0 0 0 4 &intc 0 50 3>;
		interrupt-names = "pcie_0_inta",
				  "pcie_0_intb",
				  "pcie_0_intc",
				  "pcie_0_intd";
		clocks = <&sw_pcie0>;
		clock-names = "sw_pcie";
		msi-parent = <&pcie0>;  /* use PCIe's internal MSI controller */
		msi-controller;         /* use PCIe's internal MSI controller */
		brcm,ssc;
		brcm,gen = <1>;
		supply-names = "vreg-wifi-pwr";
		supplies = <&vreg-wifi-pwr>;

	};
```

## linux/Documentation/devicetree/bindings/phy/brcm,brcmstb-usb-phy.txt
```
Broadcom STB USB PHY

Required properties:
- compatible: "brcm,brcmstb-usb-phy" - Standard STB SoC's
  	      "brcm,bcm7216-usb-phy" - SoC's with the new Synopsis controller
  	      "brcm,bcm7211-usb-phy" - 7211 SoC with Synopsis controller
- reg: a list of offset and length pairs.
- reg-names: "ctrl" - Required for all systems
  	     "xhci_ec" - Required for systems with an XHCI controller
	     "xhci_gbl - Required for systems with the new Synopsis controller
  
- #phy-cells: Shall be 1 as it expects one argument for setting
	      the type of the PHY. Possible values are:
	      - 0 for USB1.1/2.0 PHY
	      - 1 for USB3.x PHY

Optional Properties:
- clocks : clock phandles.
- clock-names: String, clock name.
- ipp: Boolean, Invert Port Power.
  Possible values are: 0 (Don't invert), 1 (Invert)
- ioc: Boolean, Invert Over Current detection.
  Possible values are: 0 (Don't invert), 1 (Invert)
- has-xhci: Boolean indicating the phy has an XHCI phy.
- has-xhci-only: Boolean indicating the phy has an XHCI phy and no
  EHCI/OHCI phy.
- device: String, PHY Device mode.
  Possible values are: "off", "on ", "dual" or "typec-pd"
  If this property is not defined, the phy will default to "off" mode.

Example:

usbphy_0: usb-phy@f0470200 {
	reg = <0xf0470200 0xb8>,
		<0xf0471940 0x6c0>;
	reg-names "ctrl", "xhci_ec"
	compatible = "brcm,brcmstb-usb-phy";
	#phy-cells = <1>;
	device = "off"
	ioc = <1>;
	ipp = <1>;
	has-xhci;
	clocks = <&usb20>, <&usb30>;
	clock-names = "sw_usb", "sw_usb3";
};
```

## linux/Documentation/devicetree/bindings/reset/brcm,reset-rescal.txt
```
BrcmSTB simple reset controller
===============================

Please also refer to reset.txt in this directory for common reset
controller binding usage.

Required properties:
- compatible: should be brcm,bcm7216-pcie-sata-rescal
- reg: register base and length
- #reset-cells: must be set to 0

Example:

rescal: reset {
	compatible = "brcm,bcm7216-pcie-sata-rescal";
	reg = <0x8b2c800>;
	#reset-cells = <0>;
};

&pcie0 {
	resets = <&rescal>;
};
```

## linux/Documentation/devicetree/bindings/serial/brcm,bcm7271-uart.txt
```
* Broadcom ns16550a UART with optional Baud Rate Mux and optional DMA

Required properties:
- compatible	  : Should be one of the following
  - "brcm,bcm7278-uart"
  - "brcm,bcm7271-uart"
  - "ns16550a"
- reg		  : offset and length of the register set for the device
- interrupts	  : should contain UART interrupt line
- clock-frequency : the input clock frequency for the UART in Hz

Optional properties:
- clocks	  : Phandle to an optional mux clock controlling the input
		    clock to the base baud divisor
- clock-names	  : "sw_baud" - required if clocks is specified

Some UARTs have an additional DMA controller. These UARTs will have
an additional four registers and an additional interrupt specified.

Properties in 8250.txt also apply

Example without DMA support:
serial@f040d000 {
	compatible = "brcm,bcm7271-uart", "ns16550a";
	reg-io-width = <0x4>;
	reg-shift = <0x2>;
	reg = <0xf040d000 0x20>;
	reg-names = "uart";
	interrupts = <0x0 0x47 0x4>;
	interrupt-names = "uart";
	fifo-size = <0x20>;
	auto-flow-control;
	clocks = <0xc>;
	clock-names = "sw_baud";
};

Example with DMA support:
serial@840e000 {
	clock-frequency = <0x4d3f640>;
	compatible = "brcm,bcm7271-uart", "ns16550a";
	reg-io-width = <0x4>;
	reg-shift = <0x2>;
	reg = <0x840e000 0x20 0x840e080 0x8 0x840e100 0xa8 0x840
	       e200 0x4c 0x840e300 0x30>;
	reg-names = "uart", "dma_arb", "dma_rx", "dma_tx", "dma_intr2";
	interrupts = <0x0 0x62 0x4 0x0 0x75 0x4>;
	interrupt-names = "uart", "dma";
	fifo-size = <0x20>;
	auto-flow-control;
	clocks = <0x9 0xfa>;
	clock-names = "sw_baud";
};
```
